## firmware/desk-gateway/main/Kconfig.projbuild
```kconfig
menu "Desk Gateway"

    config DESK_I2C_SCL_GPIO
        int "I2C SCL (CLK) GPIO"
        default 4

    config DESK_I2C_SDA_GPIO
        int "I2C SDA (DAT) GPIO"
        default 5

    config DESK_I2C_PORT
        int "I2C port number"
        range 0 1
        default 0

    config DESK_YOURDESK_HEIGHT_SNIFFER_EXPERIMENTAL
        bool "Enable experimental yourdesk_v1 GPIO height sniffer"
        depends on !DESK_YOURDESK_SOFT_I2C_MULTI_ADDRESS
        default n
        help
            当前 GPIO 边沿嗅探会与同引脚上的硬件 I2C Slave 竞争，并且无法为
            0x34-0x37 digit 地址提供 ACK。真机已观察到升降链路回归，因此默认关闭。
            仅用于协议实验；正常控桌固件不得启用。

    config DESK_YOURDESK_SOFT_I2C_MULTI_ADDRESS
        bool "Enable experimental yourdesk_v1 software multi-address I2C slave"
        default n
        help
            使用 GPIO 中断同时应答 0x24 按键地址与 0x34-0x37 高度数码管地址。
            真机排查已确认该模式会导致按键响应被中途打断，使升降断断续续。
            仅保留用于协议实验；正常控桌固件必须使用硬件 I2C Slave @0x24，
            不得启用本选项，也不能同时启用旧的只读 GPIO 高度嗅探。

    config DESK_YOURDESK_PANEL_PROXY
        bool "Enable active proxy to the original TM1650 panel"
        depends on !DESK_YOURDESK_SOFT_I2C_MULTI_ADDRESS
        default y
        help
            双 RJ45 主动代理：控制盒侧继续使用稳定的 GPIO4/5 硬件 I2C
            Slave @0x24，原厂面板侧使用 GPIO6/7 开漏软件 Master。两侧
            CLK/DAT 必须物理隔离，仅桥接 RJ45 pin1 3.3V 与 pin3 GND。
            原厂数码管显示来自 TOF400C 实测高度，避免不稳定的软件多地址
            Slave 重新进入控制链。

    config DESK_PANEL_I2C_SCL_GPIO
        int "Original panel CLK GPIO"
        depends on DESK_YOURDESK_PANEL_PROXY
        default 6

    config DESK_PANEL_I2C_SDA_GPIO
        int "Original panel DAT GPIO"
        depends on DESK_YOURDESK_PANEL_PROXY
        default 7

    config DESK_TOF_ENABLE
        bool "Enable TOF050C + TOF400C real-time telemetry"
        default y
        help
            使用独立硬件 I2C 总线采集桌面高度与右侧墙面间距。当前数据只用于
            Web、OLED 和原厂面板显示，不参与升降、档位或防碰撞控制。

    config DESK_TOF_I2C_SCL_GPIO
        int "ToF I2C SCL GPIO"
        depends on DESK_TOF_ENABLE
        default 10

    config DESK_TOF_I2C_SDA_GPIO
        int "ToF I2C SDA GPIO"
        depends on DESK_TOF_ENABLE
        default 11

    config DESK_TOF_I2C_PORT
        int "ToF I2C port number"
        depends on DESK_TOF_ENABLE
        range 0 1
        default 1

    config DESK_TOF_RIGHT_SHUT_GPIO
        int "TOF050C SHUT GPIO"
        depends on DESK_TOF_ENABLE
        default 12

    config DESK_TOF_HEIGHT_SHUT_GPIO
        int "TOF400C SHUT GPIO"
        depends on DESK_TOF_ENABLE
        default 13

    config DESK_TOF_RIGHT_OFFSET_MM
        int "TOF050C installation offset (mm)"
        depends on DESK_TOF_ENABLE
        range -200 200
        default 0
        help
            加到 TOF050C 原始读数上的固定安装偏移。首轮真机校准前保持 0。

    config DESK_OLED_ENABLE
        bool "Enable 0.91-inch SSD1306 status display"
        depends on DESK_TOF_ENABLE
        default y
        help
            在共享 GPIO10/11 I2C 总线上自动探测 0x3C/0x3D，显示高度、
            右侧间距、运动状态、传感器状态、Wi-Fi 与 BLE 摘要。
            OLED 缺失或初始化失败不会阻断其他功能。

    config DESK_AUDIO_ENABLED
        bool "Enable MAX98357A local voice playback"
        default y
        help
            通过 I2S 播放 Audio Data 分区内的固定中文 WAV 资源。功放或音频
            初始化失败只会让语音功能降级，不得阻断桌控、BLE、Wi-Fi 或 Web。

    config DESK_AUDIO_I2S_BCLK_GPIO
        int "MAX98357A I2S BCLK GPIO"
        depends on DESK_AUDIO_ENABLED
        default 14

    config DESK_AUDIO_I2S_WS_GPIO
        int "MAX98357A I2S WS/LRC GPIO"
        depends on DESK_AUDIO_ENABLED
        default 15

    config DESK_AUDIO_I2S_DOUT_GPIO
        int "MAX98357A I2S data GPIO"
        depends on DESK_AUDIO_ENABLED
        default 16

    config DESK_AUDIO_DEFAULT_VOLUME_PERCENT
        int "Default voice volume percent"
        depends on DESK_AUDIO_ENABLED
        range 0 100
        default 60

    config DESK_REMINDER_ENABLED
        bool "Enable Pomodoro voice reminder"
        default y
        depends on DESK_AUDIO_ENABLED
        help
            ESP32-S3 使用单调时钟独立计时。到期只播放语音并更新页面状态，
            绝不自动触发升桌、降桌或档位动作。

    config DESK_MOTION_TIMEOUT_MS
        int "Max continuous up/down hold (ms)"
        range 1000 60000
        default 15000

    config DESK_MOTION_DIAGNOSTICS
        bool "Enable detailed motion diagnostics"
        default y
        help
            输出升降入口、首次启动/续租、停止原因，以及运动期间每秒一次的
            驱动状态快照。用于真机排查断续运动；定位完成后可关闭，且不会
            改变运动控制、高度解析或安全限制逻辑。

    config DESK_BLE_HOLD_LEASE_MS
        int "BLE hold command lease (ms)"
        range 300 2000
        default 750
        help
            BLE 上升/下降是需要续期的短租约。客户端按住期间应以小于本值的
            周期重复写入指令；松手不再续期，即使 STOP 丢包也会自动停止。

    config DESK_MAX_HEIGHT_MM
        int "Default maximum safe height (mm)"
        range 560 940
        default 940
        help
            直接使用 TOF400C 的防抖读数。Web 设置会将用户值保存到 NVS 并
            覆盖本默认值；达到该值时驱动立即停止上升。

    config DESK_GOTO_HOLD_MS
        int "Preset goto hold (ms)"
        range 100 10000
        default 2000

    config DESK_SAVE_HOLD_MS
        int "Preset save hold (ms)"
        range 4000 10000
        default 4500

    config DESK_WEB_DEFAULT_PASSWORD
        string "Default Web password (change after first login)"
        default "desk-gateway"

    config DESK_SIM_HEIGHT
        bool "Simulate height when driver has no digit sniff"
        default n
        help
            RJ45/真桌未接或协议尚未嗅探高度时，按升/降在本地推算高度供 Web 演示。
            真高度可用后关闭本选项；切勿把 sim 高度当成实测值。

    config DESK_SIM_HEIGHT_MM_MIN
        int "Sim height min (mm)"
        depends on DESK_SIM_HEIGHT
        range 500 1500
        default 700

    config DESK_SIM_HEIGHT_MM_MAX
        int "Sim height max (mm)"
        depends on DESK_SIM_HEIGHT
        range 500 2000
        default 1200

    config DESK_SIM_HEIGHT_SPEED_MM_S
        int "Sim height speed (mm/s)"
        depends on DESK_SIM_HEIGHT
        range 5 80
        default 25

endmenu
```

## firmware/phase1-panel-slave/main/Kconfig.projbuild
```kconfig
menu "Desk Gateway Phase 1"

    config DESK_I2C_SCL_GPIO
        int "I2C SCL (CLK) GPIO"
        default 4
        help
            接控制盒 CLK。占位脚，RJ45 针脚确认后只改此处 / menuconfig，不改协议层。

    config DESK_I2C_SDA_GPIO
        int "I2C SDA (DAT) GPIO"
        default 5
        help
            接控制盒 DAT。与 SCL 同属一组飞线；必须与控制盒共地。

    config DESK_I2C_PORT
        int "I2C port number"
        range 0 1
        default 0

    config DESK_MOTION_TIMEOUT_MS
        int "Max continuous up/down hold (ms)"
        range 1000 60000
        default 15000
        help
            升/降键码最长维持时间；超时强制回 idle(0x2E)，防止飞线/任务卡死导致桌子一直动。

    config DESK_GOTO_HOLD_MS
        int "Preset goto short-code hold (ms)"
        range 100 10000
        default 2000
        help
            档位前往短码（0x17/0x2F）默认维持时长，之后自动回 idle。

    config DESK_SAVE_HOLD_MS
        int "Preset save long-code hold (ms)"
        range 4000 10000
        default 4500
        help
            档位保存长码需约 ≥4s；默认略长于 4s 以对齐抓包结论。

endmenu
```
